## config/west.yml
```yaml
manifest:
  remotes:
    - name: zmkfirmware
      url-base: https://github.com/zmkfirmware
    - name: kumamuk-git
      url-base: https://github.com/kumamuk-git
    - name: carrefinho
      url-base: https://github.com/carrefinho
  projects:
    - name: zmk
      remote: zmkfirmware
      revision: acfd8e5ea76cf23ad1c9b6b99848f97a95224257
      import: app/west.yml
    - name: zmk-pmw3610-driver
      remote: kumamuk-git
      revision: 5e04553ab803d24405bd45621a41310ea3050e59
    - name: prospector-zmk-module
      remote: carrefinho
      revision: 77a852293532879c992847e01db27abe4f94fa9f
  self:
    path: config
```
